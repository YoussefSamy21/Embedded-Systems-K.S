VERSION ""

NS_ :

BS_:

BU_: ECU2_Speed ECU1_Accelerator

BO_ 939 Speed_Val_Message: 1 ECU2_Speed
 SG_ Speed_Signal : 0|8@1+ (1,0) [0|255] ""  ECU1_Accelerator

BO_ 48 ACC_CMD_Message: 1 ECU1_Accelerator
 SG_ ACC_Signal : 0|8@1+ (1,0) [0|1] ""  ECU2_Speed
